## apps/watch/sdkconfig.defaults
```kconfig
CONFIG_IDF_TARGET="esp32s3"
CONFIG_ESPTOOLPY_FLASHSIZE_16MB=y
CONFIG_ESPTOOLPY_HEADER_FLASHSIZE_UPDATE=y
CONFIG_SPIRAM=y
CONFIG_SPIRAM_MODE_OCT=y
CONFIG_SPIRAM_SPEED_80M=y
CONFIG_SPIRAM_USE_MALLOC=y
CONFIG_ESP_DEFAULT_CPU_FREQ_MHZ_240=y
CONFIG_ESP_MAIN_TASK_STACK_SIZE=8192
CONFIG_COMPILER_WARN_WRITE_STRINGS=y
CONFIG_COMPILER_CXX_EXCEPTIONS=n
CONFIG_COMPILER_CXX_RTTI=n
CONFIG_M5SW_TEST_ID="watch"
CONFIG_M5SW_CONFIG_ID="watch"

# ディープスリープからの起床を速くする（PSRAM の起動時テストと、起床時のアプリ再検証を省く）
CONFIG_SPIRAM_MEMTEST=n
CONFIG_BOOTLOADER_SKIP_VALIDATE_IN_DEEP_SLEEP=y

# Wi-Fi の時刻合わせを入れるため、アプリ領域を広げる
CONFIG_PARTITION_TABLE_CUSTOM=y
CONFIG_PARTITION_TABLE_CUSTOM_FILENAME="partitions.csv"

# 手首を上げてから表示までを速くする（2026-11-15）
# ブートローダーの表示を警告だけにする（115200bps の UART に毎回 20 行ほど出していた）
CONFIG_BOOTLOADER_LOG_LEVEL_WARN=y
# 最適化してビルドする（-O2）
CONFIG_COMPILER_OPTIMIZATION_PERF=y
```
